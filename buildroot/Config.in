## buildroot/board/zynqmp-kria/fit-image.its
```
/dts-v1/;

/ {
    description = "U-Boot fitImage for plnx_aarch64 kernel";
    #address-cells = <1>;

    images {
        kernel@0 {
            description = "Linux Kernel";
            data = /incbin/("./Image.lzma");
            type = "kernel";
            arch = "arm64";
            os = "linux";
            compression = "lzma";
            load = <0x2000000>;
            entry = <0x2000000>;
            hash@1 {
                algo = "sha1";
            };
        };
        fdt@0 {
            description = "Flattened Device Tree blob";
            data = /incbin/("./system.dtb");
            type = "flat_dt";
            arch = "arm64";
            compression = "none";
            hash@1 {
                algo = "sha1";
            };
        };
        ramdisk@0 {
            description = "ramdisk";
            data = /incbin/("./rootfs.cpio.uboot");
            type = "ramdisk";
            arch = "arm64";
            os = "linux";
            compression = "none";
            hash@1 {
                algo = "sha1";
            };
        };
    };
    configurations {
        default = "conf@1";
        conf@1 {
            description = "Boot Linux kernel with FDT blob \+ ramdisk";
            kernel = "kernel@0";
            fdt = "fdt@0";
            ramdisk = "ramdisk@0";
            hash@1 {
                algo = "sha1";
            };
        };
    };
};
```

## buildroot/configs/zynq_zedboard_defconfig
```kconfig
# copyright 2023 Raphaël Bresson
BR2_arm=y
BR2_cortex_a9=y
BR2_CCACHE=y
BR2_ARM_ENABLE_NEON=y
BR2_ARM_ENABLE_VFP=y
BR2_TOOLCHAIN_BUILDROOT_GLIBC=y
BR2_TARGET_GENERIC_HOSTNAME="zedboard"
BR2_TARGET_GENERIC_ISSUE="Welcome to Zedboard"
BR2_TARGET_GENERIC_ROOT_PASSWD="root"
BR2_PACKAGE_HOST_LINUX_HEADERS_CUSTOM_5_15=y
BR2_ROOTFS_POST_IMAGE_SCRIPT="$(BR2_EXTERNAL_IMPL_PATH)/board/zynq-zedboard/post-image.sh"
BR2_LINUX_KERNEL=y
BR2_LINUX_KERNEL_CUSTOM_GIT=y
BR2_LINUX_KERNEL_CUSTOM_REPO_URL="https://github.com/Xilinx/linux-xlnx.git"
BR2_LINUX_KERNEL_CUSTOM_REPO_VERSION="xlnx_rebase_v5.15_LTS"
BR2_LINUX_KERNEL_USE_CUSTOM_CONFIG=y
BR2_LINUX_KERNEL_CUSTOM_CONFIG_FILE="$(BR2_EXTERNAL_IMPL_PATH)/board/zynq-zedboard/configs/linux/defconfig"
BR2_LINUX_KERNEL_UIMAGE=y
BR2_LINUX_KERNEL_UIMAGE_LOADADDR="0x8000"
BR2_LINUX_KERNEL_DTS_SUPPORT=y
BR2_LINUX_KERNEL_CUSTOM_DTS_PATH="$(BR2_EXTERNAL_IMPL_PATH)/board/zynq-zedboard/dts/gpio.h $(BR2_EXTERNAL_IMPL_PATH)/board/zynq-zedboard/dts/input.h $(BR2_EXTERNAL_IMPL_PATH)/board/zynq-zedboard/dts/irq.h $(BR2_EXTERNAL_IMPL_PATH)/board/zynq-zedboard/dts/pcw.dtsi $(BR2_EXTERNAL_IMPL_PATH)/board/zynq-zedboard/dts/phy.h $(BR2_EXTERNAL_IMPL_PATH)/board/zynq-zedboard/dts/pinctrl-zynqmp.h $(BR2_EXTERNAL_IMPL_PATH)/board/zynq-zedboard/dts/pl.dtsi $(BR2_EXTERNAL_IMPL_PATH)/board/zynq-zedboard/dts/skeleton.dtsi $(BR2_EXTERNAL_IMPL_PATH)/board/zynq-zedboard/dts/system-top.dts $(BR2_EXTERNAL_IMPL_PATH)/board/zynq-zedboard/dts/zedboard.dtsi $(BR2_EXTERNAL_IMPL_PATH)/board/zynq-zedboard/dts/zynq-7000.dtsi $(BR2_EXTERNAL_IMPL_PATH)/board/zynq-zedboard/system-user.dtsi"
BR2_PACKAGE_BUSYBOX_SHOW_OTHERS=y
BR2_PACKAGE_UBOOT_TOOLS=y
BR2_PACKAGE_I2C_TOOLS=y
BR2_TARGET_UBOOT=y
BR2_TARGET_UBOOT_BUILD_SYSTEM_KCONFIG=y
BR2_TARGET_UBOOT_CUSTOM_GIT=y
BR2_TARGET_UBOOT_CUSTOM_REPO_URL="https://github.com/Xilinx/u-boot-xlnx.git"
BR2_TARGET_UBOOT_CUSTOM_REPO_VERSION="xlnx_rebase_v2022.01_2022.2"
BR2_TARGET_UBOOT_BOARD_DEFCONFIG="xilinx_zynq_virt"
BR2_TARGET_UBOOT_CONFIG_FRAGMENT_FILES="board/zynq/zed/uboot.fragment"
BR2_TARGET_UBOOT_NEEDS_DTC=y
BR2_TARGET_UBOOT_FORMAT_CUSTOM=y
BR2_TARGET_UBOOT_FORMAT_CUSTOM_NAME="u-boot.elf"
BR2_TARGET_UBOOT_SPL=y
BR2_TARGET_UBOOT_SPL_NAME="spl/boot.bin"
BR2_TARGET_UBOOT_ZYNQ=y
BR2_PACKAGE_HOST_DOSFSTOOLS=y
BR2_PACKAGE_HOST_GENIMAGE=y
BR2_PACKAGE_HOST_MTOOLS=y
BR2_ROOTFS_OVERLAY="${BR2_EXTERNAL_IMPL_PATH}/board/zynq-zedboard/overlay"
BR2_PACKAGE_AXI_DMA_DRIVER=y
BR2_PACKAGE_AXI_DMA_API=y
```

## buildroot/configs/zynqmp_kria_cpio_defconfig
```kconfig
#
BR2_aarch64=y
BR2_CCACHE=y
BR2_OPTIMIZE_2=y
BR2_TOOLCHAIN_BUILDROOT_GLIBC=y
BR2_TARGET_GENERIC_HOSTNAME="kria"
BR2_TARGET_GENERIC_ISSUE="Welcome to Kria"
BR2_TARGET_GENERIC_ROOT_PASSWD="root"
BR2_PACKAGE_HOST_LINUX_HEADERS_CUSTOM_5_15=y
BR2_ROOTFS_POST_IMAGE_SCRIPT="$(BR2_EXTERNAL_IMPL_PATH)/board/zynqmp-kria/post-image.sh"
BR2_TARGET_ROOTFS_EXT2=y
BR2_TARGET_ROOTFS_EXT2_4=y
BR2_TARGET_ROOTFS_CPIO=y
BR2_TARGET_ROOTFS_CPIO_XZ=y
BR2_TARGET_ROOTFS_CPIO_UIMAGE=y

BR2_LINUX_KERNEL=y
BR2_LINUX_KERNEL_CUSTOM_GIT=y
BR2_LINUX_KERNEL_CUSTOM_REPO_URL="https://github.com/Xilinx/linux-xlnx.git"
BR2_LINUX_KERNEL_CUSTOM_REPO_VERSION="xlnx_rebase_v5.15_LTS_2022.2"
BR2_LINUX_KERNEL_USE_CUSTOM_CONFIG=y
BR2_LINUX_KERNEL_CUSTOM_CONFIG_FILE="$(BR2_EXTERNAL_IMPL_PATH)/board/zynqmp-kria/configs/linux/defconfig"
BR2_LINUX_KERNEL_DTS_SUPPORT=y
BR2_LINUX_KERNEL_CUSTOM_DTS_PATH="$(BR2_EXTERNAL_IMPL_PATH)/board/zynqmp-kria/dts/gpio.h $(BR2_EXTERNAL_IMPL_PATH)/board/zynqmp-kria/dts/input.h $(BR2_EXTERNAL_IMPL_PATH)/board/zynqmp-kria/dts/irq.h $(BR2_EXTERNAL_IMPL_PATH)/board/zynqmp-kria/dts/ti-dp83867.h $(BR2_EXTERNAL_IMPL_PATH)/board/zynqmp-kria/dts/phy.h $(BR2_EXTERNAL_IMPL_PATH)/board/zynqmp-kria/dts/pinctrl-zynqmp.h $(BR2_EXTERNAL_IMPL_PATH)/board/zynqmp-kria/dts/xlnx-zynqmp-clk.h $(BR2_EXTERNAL_IMPL_PATH)/board/zynqmp-kria/dts/xlnx-zynqmp-dpdma.h $(BR2_EXTERNAL_IMPL_PATH)/board/zynqmp-kria/dts/xlnx-zynqmp-power.h $(BR2_EXTERNAL_IMPL_PATH)/board/zynqmp-kria/dts/xlnx-zynqmp-resets.h $(BR2_EXTERNAL_IMPL_PATH)/board/zynqmp-kria/dts/pcw.dtsi $(BR2_EXTERNAL_IMPL_PATH)/board/zynqmp-kria/dts/pl.dtsi $(BR2_EXTERNAL_IMPL_PATH)/board/zynqmp-kria/dts/system-top.dts $(BR2_EXTERNAL_IMPL_PATH)/board/zynqmp-kria/dts/zynqmp-clk-ccf.dtsi $(BR2_EXTERNAL_IMPL_PATH)/board/zynqmp-kria/dts/zynqmp.dtsi $(BR2_EXTERNAL_IMPL_PATH)/board/zynqmp-kria/dts/zynqmp-sm-k26-reva.dtsi $(BR2_EXTERNAL_IMPL_PATH)/board/zynqmp-kria/dts/zynqmp-smk-k26-reva.dtsi $(BR2_EXTERNAL_IMPL_PATH)/board/zynqmp-kria/system-user.dtsi"
BR2_LINUX_KERNEL_NEEDS_HOST_OPENSSL=y
BR2_LINUX_KERNEL_IMAGE_TARGET_CUSTOM=y
BR2_LINUX_KERNEL_IMAGE_TARGET_NAME="Image.lzma"
BR2_LINUX_KERNEL_IMAGE_NAME="Image.lzma"

BR2_TARGET_ARM_TRUSTED_FIRMWARE=y
BR2_TARGET_ARM_TRUSTED_FIRMWARE_CUSTOM_GIT=y
BR2_TARGET_ARM_TRUSTED_FIRMWARE_CUSTOM_REPO_URL="https://github.com/Xilinx/arm-trusted-firmware.git"
BR2_TARGET_ARM_TRUSTED_FIRMWARE_CUSTOM_REPO_VERSION="xlnx_rebase_v2.6_2022.2"
BR2_TARGET_ARM_TRUSTED_FIRMWARE_PLATFORM="zynqmp"
BR2_TARGET_ARM_TRUSTED_FIRMWARE_DEBUG=y
BR2_TARGET_ARM_TRUSTED_FIRMWARE_ADDITIONAL_VARIABLES="ZYNQMP_CONSOLE=cadence1"
BR2_TARGET_ARM_TRUSTED_FIRMWARE_BL31_UBOOT=y

BR2_TARGET_UBOOT=y
BR2_TARGET_UBOOT_BUILD_SYSTEM_KCONFIG=y
BR2_TARGET_UBOOT_CUSTOM_GIT=y
BR2_TARGET_UBOOT_CUSTOM_REPO_URL="https://github.com/Xilinx/u-boot-xlnx.git"
BR2_TARGET_UBOOT_CUSTOM_REPO_VERSION="xlnx_rebase_v2022.01_2022.2"
BR2_TARGET_UBOOT_BOARD_DEFCONFIG="xilinx_zynqmp_virt"
BR2_TARGET_UBOOT_NEEDS_DTC=y
BR2_TARGET_UBOOT_NEEDS_OPENSSL=y
BR2_TARGET_UBOOT_NEEDS_ATF_BL31=y
BR2_TARGET_UBOOT_NEEDS_ATF_BL31_ELF=y
BR2_TARGET_UBOOT_FORMAT_CUSTOM=y
BR2_TARGET_UBOOT_FORMAT_CUSTOM_NAME="u-boot.elf"
BR2_TARGET_UBOOT_SPL=y
BR2_TARGET_UBOOT_SPL_NAME="spl/boot.bin"
BR2_TARGET_UBOOT_ZYNQMP=y
BR2_TARGET_UBOOT_ZYNQMP_PMUFW="$(BR2_EXTERNAL_IMPL_PATH)/board/zynqmp-kria/pmufw.elf"
BR2_TARGET_UBOOT_CUSTOM_MAKEOPTS="DEVICE_TREE=zynqmp-smk-k26-revA"
#BR2_TARGET_UBOOT_CUSTOM_MAKEOPTS="DEVICE_TREE=system-top"
#BR2_TARGET_UBOOT_CUSTOM_DTS_PATH="$(BR2_EXTERNAL_IMPL_PATH)/board/zynqmp-kria/dts/gpio.h $(BR2_EXTERNAL_IMPL_PATH)/board/zynqmp-kria/dts/xlnx-zynqmp-clk.h $(BR2_EXTERNAL_IMPL_PATH)/board/zynqmp-kria/dts/xlnx-zynqmp-dpdma.h $(BR2_EXTERNAL_IMPL_PATH)/board/zynqmp-kria/dts/xlnx-zynqmp-power.h $(BR2_EXTERNAL_IMPL_PATH)/board/zynqmp-kria/dts/xlnx-zynqmp-resets.h $(BR2_EXTERNAL_IMPL_PATH)/board/zynqmp-kria/dts/pcw.dtsi $(BR2_EXTERNAL_IMPL_PATH)/board/zynqmp-kria/dts/pl.dtsi $(BR2_EXTERNAL_IMPL_PATH)/board/zynqmp-kria/dts/system-top.dts $(BR2_EXTERNAL_IMPL_PATH)/board/zynqmp-kria/dts/zynqmp-clk-ccf.dtsi $(BR2_EXTERNAL_IMPL_PATH)/board/zynqmp-kria/dts/zynqmp.dtsi $(BR2_EXTERNAL_IMPL_PATH)/board/zynqmp-kria/system-user.dtsi"
BR2_TARGET_UBOOT_ZYNQMP_PM_CFG="$(BR2_EXTERNAL_IMPL_PATH)/board/zynqmp-kria/pm_cfg_obj.c"
BR2_TARGET_UBOOT_ZYNQMP_PSU_INIT_FILE="$(BR2_EXTERNAL_IMPL_PATH)/board/zynqmp-kria/psu_init_gpl.c"
BR2_TARGET_UBOOT_CONFIG_FRAGMENT_FILES="board/zynqmp/kria/kv260/uboot.fragment"
#BR2_TARGET_UBOOT_USE_CUSTOM_CONFIG=y
#BR2_TARGET_UBOOT_CUSTOM_CONFIG_FILE="$(BR2_EXTERNAL_IMPL_PATH)/board/zynqmp-kria/configs/uboot/defconfig"

BR2_PACKAGE_BUSYBOX_SHOW_OTHERS=y
BR2_PACKAGE_I2C_TOOLS=y
BR2_PACKAGE_UBOOT_TOOLS=y
BR2_PACKAGE_HOST_DOSFSTOOLS=y
BR2_PACKAGE_HOST_GENIMAGE=y
BR2_PACKAGE_HOST_MTOOLS=y

BR2_PACKAGE_AXI_DMA_DRIVER=y
BR2_PACKAGE_AXI_DMA_API=y

BR2_PACKAGE_XAPP_TWM=y
BR2_PACKAGE_XAPP_XCALC=y
BR2_PACKAGE_XAPP_XCLOCK=y
BR2_PACKAGE_XAPP_XEYES=y
BR2_PACKAGE_XAPP_XINIT=y
BR2_PACKAGE_XDRIVER_XF86_INPUT_KEYBOARD=y
BR2_PACKAGE_XDRIVER_XF86_INPUT_MOUSE=y
BR2_PACKAGE_XORG7=y
BR2_PACKAGE_XSERVER_XORG_SERVER=y
BR2_PACKAGE_XTERM=y
BR2_TOOLCHAIN_BUILDROOT_CXX=y
BR2_TOOLCHAIN_BUILDROOT_WCHAR=y
BR2_USE_WCHAR=y
BR2_PACKAGE_LIBDRI2=y
#BR2_PACKAGE_UBOOT_TOOLS_FIT_SUPPORT=y
#BR2_PACKAGE_HOST_UBOOT_TOOLS=y
#BR2_PACKAGE_HOST_UBOOT_TOOLS_FIT_SUPPORT=y
#BR2_PACKAGE_HOST_UBOOT_TOOLS_BOOT_SCRIPT=y

BR2_PACKAGE_XDRIVER_XF86_VIDEO_FBDEV=y
BR2_PACKAGE_XDRIVER_XF86_VIDEO_ARMSOC=y
BR2_PACKAGE_XDRIVER_XF86_VIDEO_VESA=y
BR2_PACKAGE_XAPP_XRANDR=y
BR2_PACKAGE_MALI_DRIVER=y
BR2_PACKAGE_MALI_USERSPACE_BINARIES=y
BR2_PACKAGE_FLUXBOX=y
BR2_ROOTFS_OVERLAY="${BR2_EXTERNAL_IMPL_PATH}/board/zynqmp-kria/overlay"
BR2_ROOTFS_DEVICE_CREATION_DYNAMIC_EUDEV=y
BR2_PACKAGE_LIBDRM_INSTALL_TESTS=y
BR2_PACKAGE_LIBUSB=y
```

## buildroot/package/Config.in
```kconfig
source "$BR2_EXTERNAL_IMPL_PATH/package/axi-dma-driver/Config.in"
source "$BR2_EXTERNAL_IMPL_PATH/package/axi-dma-api/Config.in"
source "$BR2_EXTERNAL_IMPL_PATH/package/mali-userspace-binaries/Config.in"
source "$BR2_EXTERNAL_IMPL_PATH/package/xdriver_xf86-video-armsoc/Config.in"
```

## buildroot/package/axi-dma-api/Config.in
```kconfig
config BR2_PACKAGE_AXI_DMA_API
  depends on BR2_PACKAGE_AXI_DMA_DRIVER
  bool "AXI DMA API"
  help
    Xilinx AXI DMA API for custom driver
```

## buildroot/package/axi-dma-driver/Config.in
```kconfig
config BR2_PACKAGE_AXI_DMA_DRIVER
  bool "AXI DMA DRIVER"
  help
    Xilinx AXI DMA custom driver
```

## buildroot/package/mali-userspace-binaries/Config.in
```kconfig
config BR2_PACKAGE_MALI_USERSPACE_BINARIES
  bool "MALI USERSPACE BINARIES"
  select BR2_PACKAGE_HAS_LIBEGBL if !BR2_PACKAGE_GLVND
  select BR2_PACKAGE_HAS_LIBGLES if !BR2_PACKAGE_GLVND
  select BR2_PACKAGE_HAS_LIBGBM  if !BR2_PACKAGE_GLVND
  help
    Mali userspace binaries for Xilinx devices

if BR2_PACKAGE_MALI_USERSPACE_BINARIES
  config BR2_PACKAGE_PROVIDES_LIBEGL
    default "mali-userspace-binaries"

  config BR2_PACKAGE_PROVIDES_LIBGLES
    default "mali-userspace-binaries"

  config BR2_PACKAGE_PROVIDES_LIBGBM
    default "mali-userspace-binaries"
endif
```

## buildroot/package/xdriver_xf86-video-armsoc/Config.in
```kconfig
config BR2_PACKAGE_XDRIVER_XF86_VIDEO_ARMSOC
  bool "xf86-video-armsoc"
  help
    armsoc mali GPU video driver for zynqmp devices
```
